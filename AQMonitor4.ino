#include <SPI.h>
#include <Wire.h>
#include "src/print/printf.h"
#include "src/epd/el029tc7.h"
#include "src/gfx/gui_paint.h"
#include "src/gfx/graphs.h"
#include "src/scd4x/SensirionI2CScd4x.h"
#include "src/sen5x/SensirionI2CSen5x.h"


#define sclk1 10
#define mosi1 11
#define miso1 12
#define sda0  14
#define scl0  15
#define stx1  20
#define srx1  21


#define POWREN 19
#define GSMPWR 13 
#define RFIDEN 16
#define EPDCEN 22
#define EPDDCP 23
#define EPDBSY 24
#define EPDRST 25
#define BTTON4 6
#define BTTON3 7
#define BTTON2 8
#define BTTON1 9
#define BTTONE 28
#define LEDIB1 29
#define PWRLVL A1

const unsigned char epd_bitmap_device_thermostat_FILL0_wght400_GRAD0_opsz48 [] = {
//0X00,0X01,0X80,0X00,0X28,0X01,
0XFF,0XFF,0XFF,0XFF,0XFF,0XFF,0XFF,0XFF,0XFF,0XFF,0XFF,0XFF,0XFF,0XFF,0XFF,0XFF,
0XFF,0XFF,0XFF,0XFF,0XFF,0XFF,0XFF,0XFF,0XFF,0XFF,0XFF,0XFF,0XFF,0XFF,0XFF,0XFF,
0XFF,0XFF,0XFF,0XFF,0XFF,0XFF,0XFF,0XFF,0XFF,0XFF,0XFF,0XFF,0XFF,0XFF,0XFF,0XFF,
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0XFF,0XFF,0XFF,0XFF,0XFF,0XFF,0XFF,0XFF,0XFF,0XFF,0XFF,0XFF,0XFF,0XFF,0XFF,0XFF,
};


uint8_t devVer = 4;
uint16_t devId = 273;
char server[] = "\"https://aqs.c3dss.com/api/Aqsdata/AddData\"";
char apn[] = "mobitel"; // "dialogbb" "mobitel" "internet"
char postData[75] = "";				
					  
char clockData[20];
char day[5], month[5], year[5], hour[5], minu[5], sec[5];
int dayi,monthi,yeari,houri,minui,seci;

uint8_t serialBuffer[128];
uint8_t buffIndex = 0;

float temparr[24];
float humidarr[24];

uint8_t postOn=1;
uint32_t postTime=6000;

uint8_t dispOn=1;
uint32_t dispTime=0;

uint8_t readOn=1;
uint32_t readTime=6000;
float pm1p0, pm2p5, pm4p0, pm10p0, humid1, temp1, vocind, noxind;
float temp2, humd2;
uint16_t co2=0;

uint8_t menuOn=0;
uint8_t btnOn=0;
uint8_t btnState=0, btnStateOld=0;
uint32_t btnTime=0;

uint8_t stateMain=1;

MbedSPI spiP1(miso1, mosi1, sclk1);
MbedI2C i2cP0(sda0, scl0);
UART uartP1(stx1, srx1);
SensirionI2CScd4x scd4x;
SensirionI2CSen5x sen5x;
EPD_EL029TC7 epd(spiP1, EPDCEN, EPDDCP, EPDRST, EPDBSY);


void setup() {

  Serial.begin(115200);
  uartP1.begin(115200);
  spiP1.begin();
  i2cP0.begin();
  delay(3000);
  Serial.print("\nAir Quality Monitor v");	Serial.println(devVer);
  Serial.print("Device Id: ");	Serial.println(devId);
  
  if(epd.begin()) {
    Serial.println("epd initialized successfuly");
  }
  initCO2();
  initAQS();
  readCO2();
  readAQS();
  showAqsData();
  Serial.println("cellular init");
  commandCellular(1);
  delay(2000);
}

void loop() {
//  switch(stateMain) {
//    case  1: 
              if(triggerButton()) {
                if((bitRead(btnState, 1) == 1) && (bitRead(btnState, 4) == 1)) {
  //                menuOn = 1;   
                } else if(bitRead(btnState, 1) == 1) {
                  handleVoid();
                } else if(bitRead(btnState, 2) == 1) {
                  readManual();
                } else if(bitRead(btnState, 3) == 1) {
                  handleVoid();
                } else if(bitRead(btnState, 4) == 1) {
                  handleVoid();
                } 
              }
              if(readOn) {
                if(millis() > readTime) {
//                  readOn=0;
                  readAQS();
				          readCO2();
                  readTime = millis() + 1000*20;
                }
              }
              if(dispOn) {
                if(millis() > dispTime) {
                  showAqsData();
                  dispTime = millis() + 1000*60;
				          for(uint8_t i=0; i<11; i++){
                    temparr[i]=temparr[i+1];
                  }
                  temparr[11]=temp1;
                  for(uint8_t i=0; i<11; i++){
                    humidarr[i]=humidarr[i+1];
                  }
                  humidarr[11]=humid1;
                }
              }
              if(postOn) {
                if(millis() > postTime) {
//                  postOn=0;
                  snprintf(postData, sizeof(postData), "%d|%.2f|%.2f|%.2f|%.2f|%.2f|%.2f|%.2f|%.2f|%d|1683701234\n", devId, pm1p0, pm2p5, pm4p0, pm10p0, humid1, temp1, vocind, noxind, co2);
                  printf(postData);
                  commandCellular(11);
                  postTime = millis() + 1000*20;
                }
              }
//  }
 
}

void showAqsData() {
  char dispTxt[50];
  char dispTxt2[50];
  snprintf(dispTxt, sizeof(dispTxt), "%.1f  %.1f  %.1f %.1f", temp1, humid1, vocind, noxind);
  snprintf(dispTxt2, sizeof(dispTxt2), "%.1f %.1f  %.1f  %.1f", pm1p0, pm2p5, pm4p0, pm10p0);
  snprintf(clockData, sizeof(clockData), "%s/%s/%s %s:%s:%s", day, month, year, hour, minu, sec);
  
  uint8_t *gfxImage;
  if ((gfxImage = (uint8_t *)malloc(epd.imageSize)) == NULL) {
    Serial.print("Failed to apply memory...\n");
    return;
  }
  Serial.print("paint gfxImage\n");
  paint_NewImage(gfxImage, EPD_WIDTH, EPD_HEIGHT, ROTATE_270, WHITE);
  paint_SelectImage(gfxImage);
  paint_Clear(WHITE);

  paint_DrawBitMap(epd_bitmap_device_thermostat_FILL0_wght400_GRAD0_opsz48);//Background
  //paint_DrawString_EN(260, 50, "101.2", &Font24, WHITE, BLACK);

  if(yeari >= 23){
  /*Date*/
  //paint_DrawString_EN(90, 0, clockData, &teko16,  WHITE, BLACK);
  paint_DrawString_EN(120, 5, clockData, &Font12,  WHITE, BLACK);
  }
  Serial.println(clockData);

  /*Temp*/
  uint16_t tempi = temp1*10;
  paint_DrawNum(18, 10, tempi/10 , &Teko32, BLACK, WHITE);
  paint_DrawNum(56, 25, tempi%10, &Teko16, BLACK, WHITE);
  paint_DrawRectangle(52, 39, 54, 41, BLACK, DOT_PIXEL_1X1, DRAW_FILL_FULL);//point
  graphs_bar(14, 54, 3, 10, 2, 12, temparr, false);

  /*Humid*/
  uint16_t humidi = humid1*10;
  paint_DrawNum(18, 73, humidi/10, &Teko32, BLACK, WHITE);
  paint_DrawNum(56, 88, humidi%10, &Teko16, BLACK, WHITE);
  paint_DrawRectangle(52, 102, 54, 104, BLACK, DOT_PIXEL_1X1, DRAW_FILL_FULL);//point
  graphs_bar(14, 117, 3, 10, 2, 12, humidarr, false);

  /*PM2p5*/
  uint16_t pm2p5i = pm2p5*10;
  if (pm2p5<10){
  paint_DrawNum(116, 58, pm2p5i/10, &Teko32, BLACK, WHITE);
  paint_DrawNum(138, 58, pm2p5i%10, &Teko32, BLACK, WHITE);
  paint_DrawRectangle(139, 85, 135, 89, BLACK, DOT_PIXEL_1X1, DRAW_FILL_FULL);//point
  }
  else if (pm2p5<100){
    paint_DrawNum(105, 58, pm2p5i/10, &Teko32, BLACK, WHITE);
    paint_DrawNum(145, 58, pm2p5i%10, &Teko32, BLACK, WHITE);
    paint_DrawRectangle(145, 85, 141, 89, BLACK, DOT_PIXEL_1X1, DRAW_FILL_FULL);//point
  }
  else{
    paint_DrawNum(98, 58, pm2p5i/10, &Teko32, BLACK, WHITE);
    paint_DrawNum(153, 58, pm2p5i%10, &Teko32, BLACK, WHITE);
    paint_DrawRectangle(154, 85, 150, 89, BLACK, DOT_PIXEL_1X1, DRAW_FILL_FULL);//point
  }

  paint_DrawString_EN(105, 99, "Good", &Font20, BLACK, WHITE);


  /*VOC*/
  uint16_t vocindi = vocind*10;
  paint_DrawNum(237, 35, vocindi/10, &Teko28Light, BLACK, WHITE);
  paint_DrawNum(277, 35, vocindi%10, &Teko28Light, BLACK, WHITE);
  paint_DrawRectangle(274, 61, 276, 63, BLACK, DOT_PIXEL_1X1, DRAW_FILL_FULL);//point

  
  /*NOX*/
  uint16_t noxindi = noxind*10;
  paint_DrawNum(240, 85, noxindi/10, &Teko28Light, BLACK, WHITE);
  paint_DrawNum(256, 85, noxindi%10, &Teko28Light, BLACK, WHITE);
  paint_DrawString_EN(256, 85, " 0", &Teko28Light, WHITE, BLACK);
  paint_DrawRectangle(252, 111, 255, 113, BLACK, DOT_PIXEL_1X1, DRAW_FILL_FULL);//point
  /*paint_DrawString_EN(0, 0, "Temp  RH%   VOC   NOx", &Font20, WHITE, BLACK);
  paint_DrawString_EN(0, 30, dispTxt, &Font20, WHITE, BLACK);
  paint_DrawString_EN(0, 60, "PM1.0  PM2.5  PM4.0 PM10.0", &Font16, WHITE, BLACK);
  paint_DrawString_EN(0, 90, dispTxt2, &Font20, WHITE, BLACK);*/
  epd.updateDisplay(gfxImage);
  delay(200);
  free(gfxImage);
  gfxImage = NULL;
}

void readManual(){
	readTime=0;
	postTime=0;
	dispTime=0;
	
  // AQS_readData();
  
  // snprintf(postData, sizeof(postData), "%d|%.2f|%.2f|%.2f|%.2f|%.2f|%.2f|%.2f|%.2f|1683701234\n",ID , pm1p0, pm2p5, pm4p0, pm10p0, humid, temp, vocind, noxind);
  // printf(postData);
  // commandCellular(10);
  // showAqsData();
}
void handleVoid() {
  Serial.println("handleVoid");
}

void initAQS() {
  bool firmwareDebug;
  uint8_t firmwareMajor;
  uint8_t firmwareMinor;
  uint8_t hardwareMajor;
  uint8_t hardwareMinor;
  uint8_t protocolMajor;
  uint8_t protocolMinor;
  uint16_t error;
  char errorMessage[256];
  float tempOffset = 0.0;
  sen5x.begin(i2cP0);

  error = sen5x.getVersion(firmwareMajor, firmwareMinor, firmwareDebug, hardwareMajor, hardwareMinor, protocolMajor, protocolMinor);
  if(error) {
    Serial.print("Error AQS Ver: ");
    errorToString(error, errorMessage, 256);
    Serial.println(errorMessage);
  } else {
    Serial.print("AQS version\tFW: "); Serial.print(firmwareMajor); Serial.print("."); Serial.print(firmwareMinor);
    Serial.print("\tHW: "); Serial.print(hardwareMajor); Serial.print("."); Serial.println(hardwareMinor);
  }

  error = sen5x.setTemperatureOffsetSimple(tempOffset);
  if(error) {
    Serial.print("Error AQS Tem: ");
    errorToString(error, errorMessage, 256);
    Serial.println(errorMessage);
  }else {
    Serial.print("Temp offset "); Serial.print(tempOffset); Serial.println("°C");
  }

  error = sen5x.startMeasurement();
  if(error) {
    Serial.print("Error trying to execute startMeasurement(): ");
    errorToString(error, errorMessage, 256);
    Serial.println(errorMessage);
  }
}
void readAQS() {
//  Serial.println("reading AQS");
  uint16_t error;
//  char errorMessage[256];

  error = sen5x.readMeasuredValues(pm1p0, pm2p5, pm4p0, pm10p0, humid1, temp1, vocind, noxind);
  if(error) {
    Serial.print("Error trying to execute readMeasuredValues(): ");
//    errorToString(error, errorMessage, 256);
//    Serial.println(errorMessage);
  } else {
    Serial.print("MassConcentrationPm1p0:");  Serial.print(pm1p0); Serial.print("\t");
    Serial.print("MassConcentrationPm2p5:");  Serial.print(pm2p5); Serial.print("\t");
    Serial.print("MassConcentrationPm4p0:");  Serial.print(pm4p0); Serial.print("\t");
    Serial.print("MassConcentrationPm10p0:"); Serial.print(pm10p0);  Serial.print("\t");
    Serial.print("AmbientHumidity:");
    if (isnan(humid1)) {
        humid1 = 0.0;
        Serial.print("n/a");
    } else {
        Serial.print(humid1);
    }
    Serial.print("\t");
    Serial.print("AmbientTemperature:");
    if (isnan(temp1)) {
        temp1 = 0.0;
        Serial.print("n/a");
    } else {
        Serial.print(temp1);
    }
    Serial.print("\t");
    Serial.print("VocIndex:");
    if (isnan(vocind)) {
        vocind = 0.0;
        Serial.print("n/a");
    } else {
        Serial.print(vocind);
    }
    Serial.print("\t");
    Serial.print("NoxIndex:");
    if (isnan(noxind)) {
        noxind = 0.0;
        Serial.println("n/a");
    } else {
        Serial.println(noxind);
    }

  }
}

void initCO2() {
  uint16_t sn0, sn1, sn2;
  uint16_t error;
  char errorMessage[256];

  scd4x.begin(i2cP0);
  delay(5);

  error = scd4x.stopPeriodicMeasurement();        // stop potentially previously started measurement
  if(error) {
    Serial.print("Error trying to execute stopPeriodicMeasurement(): ");
    errorToString(error, errorMessage, 256);
    Serial.println(errorMessage);
  }

  error = scd4x.getSerialNumber(sn0, sn1, sn2);
  if(error) {
    Serial.print("Error trying to execute getSerialNumber(): ");
    errorToString(error, errorMessage, 256);
    Serial.println(errorMessage);
  } else {
    Serial.print("CO2 serial: 0x"); Serial.print(sn0, HEX); Serial.print(sn1, HEX); Serial.println(sn2, HEX);
  }

  error = scd4x.startPeriodicMeasurement();   // Start Measurement
  if(error) {
    Serial.print("Error trying to execute startPeriodicMeasurement(): ");
    errorToString(error, errorMessage, 256);
    Serial.println(errorMessage);
  }
}
void readCO2() {
//  Serial.println("reading CO2");
  uint16_t error;
  bool isDataReady = false;
  error = scd4x.getDataReadyFlag(isDataReady);
  if(error) {
    Serial.print("Error trying to execute getDataReadyFlag(): ");
    return;
  }
  if(isDataReady) {
    error = scd4x.readMeasurement(co2, temp2, humd2);
    if(error) {
      Serial.print("Error trying to execute readMeasurement(): ");
    } else if (co2 == 0) {
      Serial.println("Invalid sample detected, skipping.");
    } else {
      Serial.print("Co2:");
      Serial.print(co2);
      Serial.print("\t");
      Serial.print("Temperature:");
      Serial.print(temp2);
      Serial.print("\t");
      Serial.print("Humidity:");
      Serial.println(humd2);
    } 
  }
  return;
}

bool triggerButton() {
  bitWrite(btnState, 1, digitalRead(BTTON1));
  bitWrite(btnState, 2, digitalRead(BTTON2));
  bitWrite(btnState, 3, digitalRead(BTTON3));
  bitWrite(btnState, 4, digitalRead(BTTON4));

  if(btnState != btnStateOld) {
    if(btnOn) {
      if(millis() > btnTime) {
        btnStateOld = btnState;
        btnOn = 0;
        if(btnState != 0x1E) {
//          printBin(btnState); Serial.println(" btn");
            Serial.print("btn: ");  Serial.println(btnState);
          return true;
        }
      }
    } else {
      btnOn = 1;
      btnTime = millis() + 80;
    }
  }
  return false;
}

uint8_t receiveCellular(uint8_t timeOut, uint8_t delim, char *chkstr1, char *chkstr2) {
  uint8_t responseCode = 0;   
  buffIndex = 0;
  uint32_t moduleTimer = millis() + (uint32_t)timeOut*1000;

  while(millis() < moduleTimer)
  {
    
    if(uartP1.available())
    {
      char rdByte = uartP1.read();
      Serial.print(rdByte);
      
      if(rdByte == delim)
      {
        if((chkstr1[0] != 0) && responseCode == 0){
//          Serial.print("\tfirst\t");  Serial.println(sizeof(chkstr1)/sizeof(chkstr1[0]));
          if(strComp(serialBuffer, buffIndex, chkstr1, strlen(chkstr1))) {
//            Serial.print("\t1 found!\n");
            responseCode = 1;
            if(chkstr2[0] == 0) {
              break;
            }
          }
        } 
        else if((chkstr2[0] != 0) && responseCode == 1) {
//          Serial.print("\tsecond\t");  Serial.println(sizeof(chkstr2)/sizeof(chkstr2[0]));
          if(strComp(serialBuffer, buffIndex, chkstr2, strlen(chkstr2))) {
//            Serial.print("\t2 found!\n");
            responseCode = 2;
            break;
          }
        }
//        else
//        {
//          if(strComp(serialBuffer, buffIndex, "ERROR", 5)) {
////          if(strstr(serialBuffer,"ERROR"))
////          {
////            Serial.print("\terror found!\n");
//            Serial.print("\t3 found!\n");
//            responseCode = 3;
//            break;
//          }
//        }
      }
      else
      {
        serialBuffer[buffIndex] = rdByte;
        buffIndex++; 
      }
    }
    
    if(!uartP1.available())
    {
      delay(20);
//      Serial.print(moduleTimer);
      Serial.print("*");
    }
  }

  Serial.println();
  return responseCode;
}
void commandCellular(uint8_t stateSIM) {
  char atOk[] = "OK";
  uint8_t atEnd = 0x0A;
  uint8_t stateTemp = stateSIM, statePrev, stateCount=0;
  for(buffIndex=0; buffIndex<128; buffIndex++ ){  serialBuffer[buffIndex] = 0; }

  while(stateSIM && (stateCount<6))
  {
//   for(buffIndex=0; buffIndex<128; buffIndex++ ){  serialBuffer[buffIndex] = 0; }
    switch(stateSIM)
    {
      case 1 : Serial.println("case 1");
               uartP1.println("AT");    
               if(receiveCellular(5,atEnd,atOk,"")) {
//                delay(1000);
                stateSIM = 2;
               } 
               else {
                delay(500);
                stateSIM = 20;
               }           
              break;
      case 2: Serial.println("case 2");
               uartP1.println("AT+CSQ");
               if(receiveCellular(5,atEnd,"CSQ: ",atOk)) {
//                SIM800_DecodeSigQuality();
                stateSIM = 3;
               }
              break;
      case 3 : Serial.println("case 3");
               uartP1.println("AT+CREG?");
               if(receiveCellular(5,atEnd,"CREG: 0,1",atOk)) {
                 stateSIM = 4;
               }
              break;
      case 4 : Serial.println("case 4");
               uartP1.println("AT+CGREG?");
               if(receiveCellular(5,atEnd,"CGREG: 0,1",atOk)) {
                 stateSIM = 5;
               }
            break;
      case 5 : Serial.println("case 5");
               uartP1.println("AT+CPSI?");
               if(receiveCellular(5,atEnd,"CPSI: LTE,Online",atOk)) {
                 stateSIM = 6;
               }
              break;
      case 6 : Serial.println("case 6");
               uartP1.print("AT+CGDCONT=1,IP,");
               uartP1.println(apn);
               if(receiveCellular(3,atEnd,atOk,"")) {
                stateSIM = 7;
               }
              break;
      case 7 : Serial.println("case 7");
               uartP1.println("AT+CGACT=1,1");
               if(receiveCellular(5,atEnd,atOk,"")) {
                stateSIM = 8;
               } else {
                stateSIM = 20; 
               }
              break;
      case 8 : Serial.println("case 8");
               uartP1.println("AT+CGACT?");
               if(receiveCellular(5,atEnd,"CGACT: 1,1",atOk)) {
                stateSIM = 9;
               } else {
                stateSIM = 20;
               }
              break;
      case 9 : Serial.println("case 9");
               uartP1.println("AT+CNTP=\"162.159.200.123\",22");
               if(receiveCellular(5,atEnd,atOk,"")) {
                stateSIM = 10;
               }
              break;
      case 10: Serial.println("case 10");
               uartP1.println("AT+CNTP");
               if(receiveCellular(5,atEnd,atOk,"")) {
                stateSIM = 11;
               }
              break;
      case 11: Serial.println("case 11");
               uartP1.println("AT+CCLK?");
               if(receiveCellular(5,atEnd,"CCLK: ",atOk)) {
                //decode
                if(stateTemp==1) {
                  stateSIM = 0;
                } else {
                  stateSIM = 12;
                }
               }
              break;

      case 12: Serial.println("case 12");
               uartP1.println("AT+HTTPINIT");
               if(receiveCellular(3,atEnd,atOk,"")) {
                stateSIM = 13;
               } else {
                stateSIM = 19;
               }
              break;             
      case 13: Serial.println("case 13");
               uartP1.print("AT+HTTPPARA=\"URL\",");
               uartP1.println(server);
               if(receiveCellular(3,atEnd,atOk,"")) {
                stateSIM = 16;
               }
              break;
//      case 14: Serial.println("case 14");
//               uartP1.println("AT+HTTPPARA=CONTENT,text/plain");
//               if(receiveCellular(3,atEnd,atOk,"")) {
//                stateSIM = 15;
//               }
//              break;
//      case 15: Serial.println("case 15");
//               uartP1.println("AT+HTTPPARA=USERDATA,AQMv2.1");
//               if(receiveCellular(3,atEnd,atOk,"")) {
//                stateSIM = 16;
//               }
//              break;
      case 16: Serial.println("case 16");
               uartP1.print("AT+HTTPDATA="); uartP1.print(strlen(postData)); uartP1.println(",2000");
               if(receiveCellular(3,atEnd,"DOWNLOAD","")) {
                uartP1.println(postData);
                if(receiveCellular(5,atEnd,atOk,"")) {
                  stateSIM = 17;
                }
               }
              break;
      case 17: Serial.println("case 17");
               uartP1.println("AT+HTTPACTION=1");
               if(receiveCellular(8,atEnd,atOk,"HTTPACTION: 1,200")) {
                stateSIM = 18;
               } else {
                Serial.println("post error");
                stateSIM = 19; 
               }
              break;
      case 18: Serial.println("case 18");
               uartP1.println("AT+HTTPREAD=0,100");
               if(receiveCellular(5,atEnd,"HTTPREAD: 0","")) {
                stateSIM = 19;
               }
              break;
      case 19 : Serial.println("case 19");
               uartP1.println("AT+HTTPTERM");
               if(receiveCellular(5,atEnd,atOk,"")) {
                stateSIM = 0;
               } else {
                stateSIM = 20;
               }
              break;
      case 20: Serial.println("case 20");  // power off and on
               digitalWrite(GSMPWR, LOW);
               Serial.println("Restarting Cellular");
               delay(750);
               digitalWrite(GSMPWR, HIGH);
               delay(8000);
               stateSIM = 1;  
              break;       
      default: Serial.println("default state");
          break;
    }
    statePrev = stateSIM;
    stateCount =+ !(statePrev^stateSIM);
  }
  Serial.println("leaving SIM_Init");
}

uint8_t strComp(uint8_t* totStr, uint8_t totStrLen, const char* subStr, uint8_t subStrLen) {
    uint8_t sok=0,si,sj,sk;
    if(totStrLen<subStrLen) {
      return sok;
    }
    for(si=0; (si<totStrLen) && (sok<1); si++) {
        if(totStr[si] == subStr[0]) {
//            Serial.print("<"); Serial.print(si); Serial.print("-"); Serial.print(totStr[si]); Serial.print(">");
            sk = si+1;
            for(sj=1, sok=1; sj<subStrLen; sj++,sk++) {
                if(totStr[sk] == subStr[sj]) {
                  sok++;
//                  Serial.print("<"); Serial.print(sk); Serial.print(":"); Serial.print(totStr[sk]); Serial.print(">");
                } else { 
                  sok=0; 
                  break; 
                }
            }
        }
    }
//    Serial.println();
    return sok;
}

void _putchar(char ch) {
  Serial.write(ch);
}
